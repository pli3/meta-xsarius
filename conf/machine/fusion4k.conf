## conf/machine/fusion4k.conf
```bitbake
#@TYPE: Machine
#@NAME: xsarius fusion4k
#@DESCRIPTION: Machine configuration for the fusion4k.

CHIP = "7252S"

IMAGEDIR = "update/fusion4k"

require conf/machine/include/xsarius4k.inc

EXTRA_IMAGEDEPENDS += " \
"

KV = "linux-3.14-28"

#MACHINE_FEATURES += "dvb-c blindscan-dvbc blindscan-dvbs hbbtv ctrlrc colorlcd transcoding dvbproxy"
MACHINE_FEATURES += "hbbtv dvbproxy"

CHIPSET = "bcm7439"

MODEL_SIZE = "200mm"

FORCE_REBOOT_OPTION = "reboot"

MACHINE_KERNEL_PR = "r1"

IMAGE_FSTYPES =+ "ext4"
```

## conf/machine/include/xsarius.inc
```bitbake
# We know about rtc
MACHINE_FEATURES_BACKFILL_CONSIDERED = "rtc"

include conf/machine/include/autoload-filesystems.inc

MACHINE_ESSENTIAL_EXTRA_RDEPENDS = " \
	xsarius-dvb-modules-${CHIPSET} \
	xsarius-kernel-params \
	xsarius-shutdown \
	ntfs-3g \
"

KERNEL_MODULE_AUTOLOAD += "xfs"

MACHINE_EXTRA_RRECOMMENDS = " \
	${@base_contains("DISTRO_VERSION", "4", "xsarius-gst-plugin-dvbmediasink", " \
	gstreamer1.0-plugin-xsarius-dvbmediasink gstreamer1.0-libav", d)} \
	splash-bootlogo \
	enigma2-plugin-extensions-hbbtv-xsarius \
	xsarius-opera-browser \
	xsarius-opera-dumpait \
	bcm \
"

TARGET_ARCH = "mipsel"
DEFAULTTUNE = "mips32el"

PREFERRED_PROVIDER_virtual/kernel = "linux-xsarius"
PREFERRED_VERSION_linux-xsarius = "4.2.1"

IMAGE_FSTYPES ?= "ubi"

UBI_VOLNAME = "rootfs"
MKUBIFS_ARGS = "-m 2048 -e 126976 -c 4096 -F"
UBINIZE_ARGS = "-m 2048 -p 128KiB"

EXTRA_IMAGECMD_COMPAT = " --eraseblock=0x20000 -n -l --pagesize=0x800 "

IMGDEPLOYDIR ?= "${DEPLOY_DIR_IMAGE}"

IMAGE_CMD_ubi_prepend = " \
        mkfs.jffs2 --root=${IMAGE_ROOTFS}/boot --faketime \
        --disable-compressor=lzo --compression-mode=size \
        --output=${DEPLOY_DIR_IMAGE}/${IMAGE_NAME}.boot.jffs2 \
        ${EXTRA_IMAGECMD_COMPAT}; rm -rf ${IMAGE_ROOTFS}/boot/; \
"

IMAGE_CMD_ubi_append = " \
	mkdir -p ${IMGDEPLOYDIR}/${IMAGEDIR}/; \
	cp -f ${IMGDEPLOYDIR}/${IMAGE_NAME}.rootfs.ubi ${IMGDEPLOYDIR}/${IMAGEDIR}/oe_rootfs.bin; \
	cp -f ${DEPLOY_DIR_IMAGE}/${MACHINE}_splash.bmp ${IMGDEPLOYDIR}/${IMAGEDIR}/splash.bmp; \
	cp -f ${DEPLOY_DIR_IMAGE}/${MACHINE}_splash1.bmp ${IMGDEPLOYDIR}/${IMAGEDIR}/splash1.bmp; \
	cp -f ${DEPLOY_DIR_IMAGE}/${MACHINE}_splash2.bmp ${IMGDEPLOYDIR}/${IMAGEDIR}/splash2.bmp; \
	cp -f ${DEPLOY_DIR_IMAGE}/${MACHINE}_splash3.bmp ${IMGDEPLOYDIR}/${IMAGEDIR}/splash3.bmp; \
	gzip -9c ${DEPLOY_DIR_IMAGE}/vmlinux-${MACHINE}.bin > ${IMGDEPLOYDIR}/${IMAGEDIR}/oe_kernel.bin; \
	cd ${IMGDEPLOYDIR}; \
	zip ${IMAGE_NAME}_usb.zip ${IMAGEDIR}/*; \
	rm -rf update; \
"

MACHINE_FEATURES += "dvb-c alsa usbhost wlan kernelwifi 3dtv switchoff osdposition hdmicec dvbusb"

require conf/machine/include/tune-mips32.inc
require conf/machine/include/xsarius-wifi.inc
require conf/machine/include/xsarius-dvb-usb.inc
```

## conf/machine/include/xsarius4k.inc
```bitbake
# We know about rtc
MACHINE_FEATURES_BACKFILL_CONSIDERED = "rtc"

MACHINE_ESSENTIAL_EXTRA_RDEPENDS = " \
	${@base_contains("GST_VERSION", "1.0", "gstreamer1.0-libav", "gst-ffmpeg", d)} \
        xsarius-initrd-${MACHINE} \
        xsarius-shutdown \
        xsarius-dvb-modules-bcm7252s \
"

KERNEL_MODULE_AUTOLOAD += "xfs"

MACHINE_EXTRA_RRECOMMENDS = " \
	xsarius-gstreamer1.0-plugin-dvbmediasink \
	ntfs-3g \
"

EXTRA_IMAGEDEPENDS += "\
                   splash-bootlogo \
"

TARGET_ARCH = "arm"
DEFAULTTUNE = "armv7ahf-neon"

DVBMEDIASINK_CONFIG = "--with-dags --with-pcm --with-eac3 --with-amr --with-wmv --with-vb6 --with-vb8 --with-spark --with-h265"

PREFERRED_VERSION_linux-xsarius = "3.14.28"

PREFERRED_PROVIDER_virtual/kernel = "linux-xsarius"

IMAGE_FSTYPES ?= "tar.bz2"

IMAGEDIR ?= "${MACHINE}"
IMGDEPLOYDIR ?= "${DEPLOY_DIR_IMAGE}"

IMAGE_CMD_tar_prepend = " \
	mkdir -p ${IMGDEPLOYDIR}/update/${UPDATE_DIR}/; \
        cp -f ${IMGDEPLOYDIR}/${MACHINE}_splash.bmp ${IMGDEPLOYDIR}/update/${UPDATE_DIR}/splash.bmp; \
        cp ${IMAGE_ROOTFS}/tmp/zImage ${IMGDEPLOYDIR}/update/${MACHINE}/oe_kernel.bin; \
        cp ${IMAGE_ROOTFS}/boot/initrd_run.bin ${IMGDEPLOYDIR}/update/${UPDATE_DIR}/initrd_run.bin; \
        rm -rf ${IMAGE_ROOTFS}/tmp/zImage; \
        rm -rf ${IMAGE_ROOTFS}/boot/initrd_run.bin; \
        tar -cvf ${IMGDEPLOYDIR}/rootfs.tar -C ${IMAGE_ROOTFS} .; \
        mv ${IMGDEPLOYDIR}/rootfs.tar ${IMGDEPLOYDIR}/update/${UPDATE_DIR}/rootfs.tar; \
        bzip2 ${IMGDEPLOYDIR}/update/${MACHINE}/rootfs.tar; \
        cd ${IMGDEPLOYDIR}; \
        zip ${IMAGE_NAME}_usb.zip update/${UPDATE_DIR}/*; \
        rm -rf update; \
"

MACHINE_FEATURES += "alsa usbhost wlan kernelwifi extrakernelwifi 3dtv switchoff osdposition hdmicec"

require conf/machine/include/arm/arch-armv7a.inc
require conf/machine/include/xsarius-wifi.inc
require conf/machine/include/xsarius-dvb-usb.inc
```

## conf/machine/purehdse.conf
```bitbake
#@TYPE: Machine
#@NAME: purehd
#@DESCRIPTION: Machine configuration for the Xsarius purehd

IMAGEDIR ?= "update/purehd/cfe"

BRANDTYPE = "XSARIUS"

CHIPSET = "bcm73625"

require conf/machine/include/xsarius.inc
```
